## main/Kconfig.projbuild
```kconfig
menu "DS1307 Configuration"

    config GPIO_RANGE_MAX
        int
        default 33 if IDF_TARGET_ESP32
        default 46 if IDF_TARGET_ESP32S2
        default 48 if IDF_TARGET_ESP32S3
        default 18 if IDF_TARGET_ESP32C2
        default 19 if IDF_TARGET_ESP32C3
        default 30 if IDF_TARGET_ESP32C6
        default 27 if IDF_TARGET_ESP32H2

    config SCL_GPIO
        int "DS1307 SCL GPIO number"
        range 0 GPIO_RANGE_MAX
        default 22 if IDF_TARGET_ESP32
        default  2 if IDF_TARGET_ESP32S2 || IDF_TARGET_ESP32S3
        default  2 if IDF_TARGET_ESP32H2
        default  6 # C3 and others
        help
            GPIO number (IOxx) to DS1307 SCL.
            Some GPIOs are used for other purposes (flash connections, etc.) and cannot be used to CS.
            GPIOs 35-39 are input-only so cannot be used as outputs.

    config SDA_GPIO
        int "DS1307 SDA GPIO number"
        range 0 GPIO_RANGE_MAX
        default 21 if IDF_TARGET_ESP32
        default  1 if IDF_TARGET_ESP32S2 || IDF_TARGET_ESP32S3
        default  1 if IDF_TARGET_ESP32H2
        default  5 # C3 and others
        help
            GPIO number (IOxx) to DS1307 SDA.
            Some GPIOs are used for other purposes (flash connections, etc.) and cannot be used to DC.
            GPIOs 35-39 are input-only so cannot be used as outputs.

    config TIMEZONE
        int "Your TimeZone"
        range -23 23
        default 0
        help
            Your local timezone.
            When it is 0, Greenwich Mean Time.

    choice MODE
        prompt "Access Mode"
        default SET_CLOCK
        help
            Select mode for the example.
        config SET_CLOCK
            bool "Set Clock & Get Clock"
            help
                Set clock to DS1302 & Get clock from DS1302.
        config GET_CLOCK
            bool "Only Get Clock"
            help
                Get clock from DS1302.
        config DIFF_CLOCK
            bool "Get the time difference"
            help
                Get the time difference of NTP and RTC.
    endchoice

if SET_CLOCK || DIFF_CLOCK
    config NTP_SERVER
        string "NTP Server"
        default "pool.ntp.org"
        help
            Hostname for NTP Server.
endif

endmenu
```
